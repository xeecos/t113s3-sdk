## configs/buildroot/t113_s3_defconfig
```kconfig
# Buildroot 配置: T113-S3 (仅构建根文件系统, 内核/U-Boot 由本项目脚本统一编译)
# 应用: make rootfs-buildroot

BR2_arm=y
BR2_cortex_a7=y
BR2_ARM_FPU_NEON_VFPV4=y

# 工具链: buildroot 自建 glibc (与全志闭源 blob 兼容性最好)
BR2_TOOLCHAIN_BUILDROOT_GLIBC=y
BR2_TOOLCHAIN_BUILDROOT_CXX=y

# 系统基础
BR2_TARGET_GENERIC_HOSTNAME="t113-s3"
BR2_TARGET_GENERIC_ISSUE="Welcome to T113-S3 (buildroot)"
BR2_ROOTFS_DEVICE_CREATION_DYNAMIC_DEVTMPFS=y
BR2_TARGET_GENERIC_GETTY_PORT="ttyS3"
BR2_TARGET_GENERIC_GETTY_BAUDRATE_115200=y
BR2_SYSTEM_DHCP="eth0"

# 常用工具 (按需增删)
BR2_PACKAGE_ETHTOOL=y
BR2_PACKAGE_I2C_TOOLS=y
BR2_PACKAGE_MEMTESTER=y
BR2_PACKAGE_EVEMU=n
BR2_PACKAGE_DROPBEAR=y
BR2_PACKAGE_HTOP=y

# 根文件系统: ext4, 供 pack-image.sh 直接使用
BR2_TARGET_ROOTFS_EXT2=y
BR2_TARGET_ROOTFS_EXT2_4=y
BR2_TARGET_ROOTFS_EXT2_LABEL="rootfs"
BR2_TARGET_ROOTFS_EXT2_SIZE="192M"
BR2_TARGET_ROOTFS_EXT2_MKFS_OPTIONS="-O ^metadata_csum"
```
